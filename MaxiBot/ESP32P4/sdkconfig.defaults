## MaxiBot/ESP32P4/sdkconfig.defaults
```kconfig
CONFIG_IDF_TARGET="esp32p4"
CONFIG_SPIRAM=y
CONFIG_SPIRAM_SPEED_200M=y
CONFIG_ESP_CONSOLE_USB_SERIAL_JTAG=y
CONFIG_CAMERA_OV5647=y
CONFIG_ESP_VIDEO_ENABLE_ISP_PIPELINE_CONTROLLER=y
CONFIG_IDF_EXPERIMENTAL_FEATURES=y
CONFIG_ESP32P4_SELECTS_REV_LESS_V3=y
CONFIG_ESP32P4_REV_MIN_100=y
CONFIG_ESPTOOLPY_FLASHFREQ_40M=y
CONFIG_FORMAT_MJPEG_CAM1=y
CONFIG_SLAVE_IDF_TARGET_ESP32=y
CONFIG_ESP_HOSTED_HOST_TRANSPORT_BUS_SPI=y
CONFIG_ESP_HOSTED_HOST_SPI_MOSI_GPIO=23
CONFIG_ESP_HOSTED_HOST_SPI_MISO_GPIO=34
CONFIG_ESP_HOSTED_HOST_SPI_CLK_GPIO=33
CONFIG_ESP_HOSTED_HOST_SPI_CS_GPIO=32
CONFIG_ESP_HOSTED_HOST_HANDSHAKE_GPIO=26
CONFIG_ESP_HOSTED_HOST_DATA_READY_GPIO=27
CONFIG_ESP_HOSTED_HOST_RESET_GPIO=22
CONFIG_ESP_HOSTED_HOST_SPI_MODE=2
CONFIG_ESPTOOLPY_FLASHSIZE_16MB=y
CONFIG_PARTITION_TABLE_SINGLE_APP_LARGE=y
# Throughput over ESP-Hosted, as in the esp_hosted iperf example
CONFIG_LWIP_TCP_SND_BUF_DEFAULT=65534
CONFIG_LWIP_TCP_WND_DEFAULT=65534
CONFIG_LWIP_TCP_RECVMBOX_SIZE=64
CONFIG_LWIP_TCPIP_RECVMBOX_SIZE=64
CONFIG_LWIP_TCP_SACK_OUT=y
CONFIG_LWIP_IRAM_OPTIMIZATION=y
CONFIG_WIFI_RMT_DYNAMIC_TX_BUFFER_NUM=64
```

## MaxiBot/sdkconfig.defaults
```kconfig
CONFIG_IDF_TARGET="esp32p4"
CONFIG_SPIRAM=y
CONFIG_SPIRAM_SPEED_200M=y
CONFIG_ESP_CONSOLE_UART_DEFAULT=y
CONFIG_ESP_CONSOLE_SECONDARY_NONE=y
CONFIG_CAMERA_OV5647=y
CONFIG_ESP_VIDEO_ENABLE_ISP_PIPELINE_CONTROLLER=y
CONFIG_IDF_EXPERIMENTAL_FEATURES=y
CONFIG_ESP32P4_SELECTS_REV_LESS_V3=y
CONFIG_ESP32P4_REV_MIN_100=y
CONFIG_ESPTOOLPY_FLASHFREQ_40M=y
```
